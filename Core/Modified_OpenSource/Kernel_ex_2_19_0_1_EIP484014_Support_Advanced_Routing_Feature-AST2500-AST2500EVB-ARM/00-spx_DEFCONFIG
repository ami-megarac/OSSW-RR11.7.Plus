## Core/Modified_OpenSource/Kernel_ex_2_19_0_1_EIP484014_Support_Advanced_Routing_Feature-AST2500-AST2500EVB-ARM/00-spx_DEFCONFIG
```kconfig
--- .pristine/Kernel_ex-2.19.0-ARM-AST2500-AST2500EVB-src/spx/DEFCONFIG	Tue Jul 23 18:00:08 2019
+++ source/Kernel_ex-2.19.0-ARM-AST2500-AST2500EVB-src/spx/DEFCONFIG	Tue Jul 23 18:09:12 2019
@@ -461,7 +461,11 @@
 # CONFIG_NET_KEY is not set
 CONFIG_INET=y
 CONFIG_IP_MULTICAST=y
-# CONFIG_IP_ADVANCED_ROUTER is not set
+CONFIG_IP_ADVANCED_ROUTER=y
+CONFIG_IP_FIB_TRIE_STATS=y
+CONFIG_IP_MULTIPLE_TABLES=y
+CONFIG_IP_ROUTE_MULTIPATH=y
+CONFIG_IP_ROUTE_VERBOSE=y
 CONFIG_IP_ROUTE_CLASSID=y
 CONFIG_IP_PNP=y
 CONFIG_IP_PNP_DHCP=y
```
